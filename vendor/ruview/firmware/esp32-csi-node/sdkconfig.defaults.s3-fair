## vendor/ruview/firmware/esp32-csi-node/sdkconfig.defaults.s3-fair
```kconfig
# ADR-110 apples-to-apples S3 overlay for fair vs-C6 size comparison.
# Same target as production S3 but with the features that aren't on C6 disabled:
#   - No AMOLED display (ADR-045 — C6 has no PSRAM for framebuffers)
#   - No WASM3 (ADR-040 — same reason)
#   - No mmWave fusion (separate board)
# This is NOT a production build — only used to answer "is C6 smaller than S3
# once you strip the S3-only features?"
#
# Build:
#   cp sdkconfig.defaults.s3-fair sdkconfig.defaults && idf.py set-target esp32s3 && idf.py build
#   # Restore default:  git checkout sdkconfig.defaults

CONFIG_IDF_TARGET="esp32s3"
CONFIG_PARTITION_TABLE_CUSTOM=y
CONFIG_PARTITION_TABLE_CUSTOM_FILENAME="partitions_4mb.csv"
CONFIG_ESPTOOLPY_FLASHSIZE_4MB=y
CONFIG_ESPTOOLPY_FLASHSIZE="4MB"
CONFIG_COMPILER_OPTIMIZATION_SIZE=y
CONFIG_ESP_WIFI_CSI_ENABLED=y
CONFIG_BOOTLOADER_LOG_LEVEL_WARN=y
CONFIG_LOG_DEFAULT_LEVEL_INFO=y
CONFIG_LWIP_SO_RCVBUF=y
CONFIG_ESP_MAIN_TASK_STACK_SIZE=8192
CONFIG_FREERTOS_TIMER_TASK_STACK_DEPTH=8192

# Disable display + WASM + mmWave for apples-to-apples vs C6.
# CONFIG_DISPLAY_ENABLE is not set
# CONFIG_WASM_ENABLE is not set
```
